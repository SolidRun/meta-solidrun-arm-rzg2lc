## meta-rzg2l/conf/machine/rzv2l-sr-som.conf
```bitbake
#@TYPE: Machine
#@NAME: SolidRun RZ/G2L SYstem on Module
#@DESCRIPTION: Machine configuration for SolidRun RZ/G2L SoM on HummingBoard Ripple

require conf/machine/include/rzg2l-sr-som-common.conf

MACHINE_FEATURES:append = " hwh264dec hwh264enc"

# Linux kernel configuration
KERNEL_DEVICETREE += " \
	renesas/${SR_MMC_OVERLAY} \
	renesas/${SR_SD_OVERLAY} \
	renesas/r9a07g054l2-hummingboard-iiot.dtb \
	renesas/rzg2l-hummingboard-iiot-panel-dsi-WJ70N3TYJHMNG0.dtbo \
	renesas/rzg2l-hummingboard-iiot-rs485-a.dtbo \
	renesas/rzg2l-hummingboard-iiot-rs485-b.dtbo \
	renesas/r9a07g054l2-hummingboard-pro.dtb \
	renesas/r9a07g054l2-hummingboard-ripple.dtb \
"

# Trusted Firmware-A configuration
TFA_PLATFORM ?= "v2l"
TFA_BOARD ?= "sr_rzv2l"

# U-Boot Configuration
UBOOT_CONFIG ??= "rzv2l-hummingboard"

# Flash Writer configuration
FLASH_WRITER_BOARD ?= "RZV2L_HUMMINGBOARD"

# install DTBs with renesas/ prefix
IMAGE_BOOT_FILES:append = " \
	r9a07g054l2-hummingboard-iiot.dtb;renesas/r9a07g054l2-hummingboard-iiot.dtb \
	rzg2l-hummingboard-iiot-panel-dsi-WJ70N3TYJHMNG0.dtbo;renesas/rzg2l-hummingboard-iiot-panel-dsi-WJ70N3TYJHMNG0.dtbo \
	rzg2l-hummingboard-iiot-rs485-a.dtbo;renesas/rzg2l-hummingboard-iiot-rs485-a.dtbo \
	rzg2l-hummingboard-iiot-rs485-b.dtbo;renesas/rzg2l-hummingboard-iiot-rs485-b.dtbo \
	r9a07g054l2-hummingboard-pro.dtb;renesas/r9a07g054l2-hummingboard-pro.dtb \
	r9a07g054l2-hummingboard-ripple.dtb;renesas/r9a07g054l2-hummingboard-ripple.dtb \
"
# HACK: place one sentinel dtb without renesas/ prefix to fix wic image generated extlinux.conf fdtdir path
IMAGE_BOOT_FILES:prepend = " r9a07g054l2-hummingboard-ripple.dtb;sentinel.dtb "

# include drivers & support packages
MACHINE_ESSENTIAL_EXTRA_RDEPENDS:append = " \
	linux-firmware-sr-rz-cyw43455 \
"
```

## meta-rzv2n/conf/layer.conf
```bitbake
# We have a conf and classes directory, add to BBPATH
BBPATH .= ":${LAYERDIR}"

# We have recipes-* directories, add to BBFILES
# Explicitly list to avoid wildcard matching dynamic-layers subdirectory
BBFILES += "${LAYERDIR}/recipes-bsp/*/*.bb \
            ${LAYERDIR}/recipes-bsp/*/*.bbappend \
            ${LAYERDIR}/recipes-graphics/*/*.bb \
            ${LAYERDIR}/recipes-graphics/*/*.bbappend \
            ${LAYERDIR}/recipes-kernel/*/*.bb \
            ${LAYERDIR}/recipes-kernel/*/*.bbappend \
            ${LAYERDIR}/recipes-kernel/*/*/*.bb \
            ${LAYERDIR}/recipes-kernel/*/*/*.bbappend \
            ${LAYERDIR}/recipes-multimedia/*/*.bb \
            ${LAYERDIR}/recipes-multimedia/*/*.bbappend \
            ${LAYERDIR}/recipes-rz-boards-compat/*/*.bb \
            ${LAYERDIR}/recipes-rz-boards-compat/*/*.bbappend \
            ${LAYERDIR}/recipes-support/*/*.bb \
            ${LAYERDIR}/recipes-support/*/*.bbappend"

BBFILE_COLLECTIONS += "solidrun-rz-v2n"
BBFILE_PATTERN_solidrun-rz-v2n = "^${LAYERDIR}/"
BBFILE_PRIORITY_solidrun-rz-v2n= "16"
LAYERVERSION_solidrun-rz-v2n = "1"
LAYERSERIES_COMPAT_solidrun-rz-v2n = "scarthgap"
LAYERDEPENDS_solidrun-rz-v2n = "solidrun-rz"

# Satisfy meta-rz-boards dependency for meta-rz-drpai and meta-rz-opencva.
# The proprietary Renesas AI SDK layers expect a meta-rz-boards layer providing
# EVK board support. SolidRun provides its own board support via this layer.
# A placeholder recipe is provided so the collection pattern matches at least
# one file, avoiding the "No bb files matched" warning.
BBFILE_COLLECTIONS += "meta-rz-boards"
BBFILE_PATTERN_meta-rz-boards = "^${LAYERDIR}/recipes-rz-boards-compat/"
BBFILE_PRIORITY_meta-rz-boards = "1"
LAYERSERIES_COMPAT_meta-rz-boards = "scarthgap"
BBFILES += "${LAYERDIR}/recipes-rz-boards-compat/*/*.bb"

BBFILES_DYNAMIC += " \
    meta-rz-codecs:${LAYERDIR}/dynamic-layers/meta-rz-codecs/recipes-drp/*/*.bbappend \
    meta-rz-codecs:${LAYERDIR}/dynamic-layers/meta-rz-codecs/recipes-firmware/*/*.bbappend \
    meta-rz-codecs:${LAYERDIR}/dynamic-layers/meta-rz-codecs/recipes-kernel/*/*.bbappend \
    meta-rz-codecs:${LAYERDIR}/dynamic-layers/meta-rz-codecs/recipes-multimedia/*/*.bbappend \
    meta-rz-graphics:${LAYERDIR}/dynamic-layers/meta-rz-graphics/recipes-graphics/*/*.bbappend \
    meta-rz-graphics:${LAYERDIR}/dynamic-layers/meta-rz-graphics/recipes-kernel/*/*.bbappend \
    meta-rz-graphics:${LAYERDIR}/dynamic-layers/meta-rz-graphics/recipes-kernel/*/*/*.bbappend \
    rz-drpai:${LAYERDIR}/dynamic-layers/rz-drpai/recipes-bsp/*/*.bbappend \
    rz-drpai:${LAYERDIR}/dynamic-layers/rz-drpai/recipes-drp/*/*.bbappend \
    rz-drpai:${LAYERDIR}/dynamic-layers/rz-drpai/recipes-firmware/*/*.bbappend \
    rz-drpai:${LAYERDIR}/dynamic-layers/rz-drpai/recipes-kernel/*/*.bbappend \
    rz-drpai:${LAYERDIR}/dynamic-layers/rz-drpai/recipes-kernel/*/*/*.bbappend \
    rz-opencva:${LAYERDIR}/dynamic-layers/rz-opencva/recipes-bsp/*/*.bbappend \
    ros2-humble-layer:${LAYERDIR}/dynamic-layers/ros2-humble-layer/recipes-ros2-control/*/*.bbappend \
"

# Skip boot-overlays recipe from meta-rzg2l as V2N doesn't have SD/MMC overlays
BBMASK += "meta-rzg2l/recipes-bsp/boot-overlays"

# Skip dangling librealsense2 bbappend from meta-rzv2-ros-humble
BBMASK += "meta-rzv2-ros-humble/recipes-realsense2"

# Skip obsolete ROS2 control bbappends from meta-ros2-humble
# The patches fail to apply with current ROS2 version and are no longer needed
BBMASK += "meta-ros/meta-ros2-humble/recipes-bbappends/ros2-control/hardware-interface"
BBMASK += "meta-ros/meta-ros2-humble/recipes-bbappends/ros2-control/controller-interface"
BBMASK += "meta-ros/meta-ros2-humble/recipes-bbappends/ros2-control/controller-manager"
```

## meta/conf/layer.conf
```bitbake
# We have a conf and classes directory, add to BBPATH
BBPATH .= ":${LAYERDIR}"

# We have recipes-* directories, add to BBFILES
# Explicitly list to avoid wildcard matching sublayer dynamic-layers
BBFILES += "${LAYERDIR}/recipes-kernel/*/*.bb \
            ${LAYERDIR}/recipes-kernel/*/*.bbappend \
            ${LAYERDIR}/recipes-solidrun/*/*.bb \
            ${LAYERDIR}/recipes-solidrun/*/*.bbappend"

BBFILE_COLLECTIONS += "solidrun-rz"
BBFILE_PATTERN_solidrun-rz = "^${LAYERDIR}/"
BBFILE_PRIORITY_solidrun-rz = "15"
LAYERVERSION_solidrun-rz = "1"
LAYERSERIES_COMPAT_solidrun-rz = "scarthgap"

# enable virtualization features if meta-virtualization is available
# this reduces user instructions enabling docker to "bitbake-layers add-layer .." only.
DISTRO_FEATURES:append = " ${@bb.utils.contains('BBFILE_COLLECTIONS', 'virtualization-layer', 'virtualization docker', '', d)} "
```
