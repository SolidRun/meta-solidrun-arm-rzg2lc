## conf/machine/rzg2l-eu205.conf
```bitbake
require conf/machine/rzg2l-hummingboard.conf

MACHINEOVERRIDES .= ":eu205"

KERNEL_DEVICETREE:append = " renesas/rzg2l-eu205.dtb"
IMAGE_BOOT_FILES:append = " rzg2l-eu205.dtb;renesas/rzg2l-eu205.dtb"

MACHINE_ESSENTIAL_EXTRA_RRECOMMENDS:append= " kernel-module-ppp-async kernel-module-ppp-generic kernel-module-rswlan linux-firmware-rswlan"

RSWLAN_MODULE_TYPE = "spi"
```

## conf/machine/rzg2l-hummingboard.conf
```bitbake
#@TYPE: Machine
#@NAME: SolidRun RZ/G2L HummingBoard
#@DESCRIPTION: Machine configuration for SolidRun RZ/G2L HummingBoard machines

SOC_FAMILY = "r9a07g044l"
require conf/machine/include/rzg2l-common.inc
require conf/machine/solidrun-rz-common.inc

UBOOT_CONFIG ??= "rzg2l-hummingboard"
UBOOT_CONFIG[rzg2l-hummingboard] = "rzg2l-solidrun_defconfig"

OVERLAY_PREFIX = "rzg2l-solidrun"

# Supported devicetree
KERNEL_DEVICETREE = " \
        renesas/rzg2l-hummingboard-ripple.dtb \
        renesas/rzg2l-hummingboard-pro.dtb \
        renesas/rzg2l-hummingboard-extended.dtb \
        renesas/rzg2l-hummingboard-iiot.dtb \
        renesas/${OVERLAY_PREFIX}-sd-overlay.dtbo \
        renesas/${OVERLAY_PREFIX}-mmc-overlay.dtbo \
"

# list files for boot partition (wic image)
IMAGE_BOOT_FILES ?= " \
        ${KERNEL_IMAGETYPE} \
        rzg2l-hummingboard-ripple.dtb;dtb/renesas/rzg2l-hummingboard-ripple.dtb \
        rzg2l-hummingboard-pro.dtb;renesas/dtb/rzg2l-hummingboard-pro.dtb \
        rzg2l-hummingboard-extended.dtb;dtb/renesas/rzg2l-hummingboard-extended.dtb \
        rzg2l-hummingboard-extended.dtb;dtb/renesas/rzg2l-hummingboard-iiot.dtb \
        ${OVERLAY_PREFIX}-sd-overlay.dtbo;dtb/renesas/${OVERLAY_PREFIX}-sd-overlay.dtbo \
        ${OVERLAY_PREFIX}-mmc-overlay.dtbo;dtb/renesas/${OVERLAY_PREFIX}-mmc-overlay.dtbo \
"

MACHINEOVERRIDES .= ":solidrun-rzg2l-som"
```

## conf/machine/rzg2lc-eu205.conf
```bitbake
require conf/machine/rzg2lc-hummingboard.conf

MACHINEOVERRIDES .= ":eu205"

KERNEL_DEVICETREE:append = " renesas/rzg2lc-eu205.dtb"
IMAGE_BOOT_FILES:append = " rzg2lc-eu205.dtb;renesas/rzg2lc-eu205.dtb"

MACHINE_ESSENTIAL_EXTRA_RRECOMMENDS:append= " kernel-module-ppp-async kernel-module-ppp-generic kernel-module-rswlan linux-firmware-rswlan"

RSWLAN_MODULE_TYPE = "spi"
```

## conf/machine/rzg2lc-hummingboard.conf
```bitbake
#@TYPE: Machine
#@NAME: SolidRun RZ/G2LC HummingBoard
#@DESCRIPTION: Machine configuration for SolidRun RZ/G2LC HummingBoard machines

SOC_FAMILY = "r9a07g044c"
require conf/machine/include/rzg2l-common.inc
require conf/machine/solidrun-rz-common.inc

UBOOT_CONFIG ??= "rzg2lc-hummingboard"
UBOOT_CONFIG[rzg2lc-hummingboard] = "rzg2lc-solidrun_defconfig"

OVERLAY_PREFIX = "rzg2lc-solidrun"

# Supported devicetree
KERNEL_DEVICETREE = " \
        renesas/rzg2lc-hummingboard.dtb \
        renesas/rzg2lc-hummingboard-iiot.dtb \
        renesas/${OVERLAY_PREFIX}-sd-overlay.dtbo \
        renesas/${OVERLAY_PREFIX}-mmc-overlay.dtbo \
"

# list files for boot partition (wic image)
IMAGE_BOOT_FILES ?= " \
        ${KERNEL_IMAGETYPE} \
        rzg2lc-hummingboard.dtb;dtb/renesas/rzg2lc-hummingboard.dtb \
        rzg2lc-hummingboard-iiot.dtb;dtb/renesas/rzg2lc-hummingboard-iiot.dtb \
        ${OVERLAY_PREFIX}-sd-overlay.dtbo;dtb/renesas/${OVERLAY_PREFIX}-sd-overlay.dtbo \
        ${OVERLAY_PREFIX}-mmc-overlay.dtbo;dtb/renesas/${OVERLAY_PREFIX}-mmc-overlay.dtbo \
"

MACHINEOVERRIDES .= ":solidrun-rzg2lc-som"
```

## conf/machine/rzg2lc-som-solidrun.conf
```bitbake
#@TYPE: Machine
#@NAME: rzg2lc-som-solidrun machine
#@DESCRIPTION: RZ/G2LC Solidrun platform

SOC_FAMILY = "r9a07g044c"
require conf/machine/include/rzg2l-common.inc
require conf/machine/include/cip-core.inc

DEFAULTTUNE ?= "cortexa55"

TUNE_CONF ?= "conf/machine/include/tune-cortexa55.inc"
require ${TUNE_CONF}

PREFERRED_PROVIDER_virtual/kernel="linux-renesas"

UBOOT_CONFIG ??= "rzg2lc-som-solidrun"
UBOOT_CONFIG[rzg2lc-som-solidrun] = "rzg2lc-som-solidrun_defconfig"

# flash writer
EXTRA_IMAGEDEPENDS += " flash-writer"

# Supported devicetree
KERNEL_DEVICETREE = " \
        solidrun/rzg2lc-som-solidrun.dtb \
"
```

## conf/machine/rzv2l-hummingboard.conf
```bitbake
#@TYPE: Machine
#@NAME: SolidRun RZ/V2L HummingBoard
#@DESCRIPTION: Machine configuration for SolidRun RZ/V2L HummingBoard machines

SOC_FAMILY = "r9a07g054l"
require conf/machine/include/rzv2l-common.inc
require conf/machine/solidrun-rz-common.inc

UBOOT_CONFIG ??= "rzv2l-hummingboard"
UBOOT_CONFIG[rzv2l-hummingboard] = "rzv2l-solidrun_defconfig"

OVERLAY_PREFIX = "rzg2l-solidrun"

# Supported devicetree
KERNEL_DEVICETREE = " \
        renesas/rzv2l-hummingboard-ripple.dtb \
        renesas/rzv2l-hummingboard-extended.dtb \
        renesas/rzv2l-hummingboard-pro.dtb \
        renesas/rzv2l-hummingboard-iiot.dtb \
        renesas/${OVERLAY_PREFIX}-sd-overlay.dtbo \
        renesas/${OVERLAY_PREFIX}-mmc-overlay.dtbo \
"

# list files for boot partition (wic image)
IMAGE_BOOT_FILES ?= " \
        ${KERNEL_IMAGETYPE} \
        rzv2l-hummingboard-ripple.dtb;dtb/renesas/rzv2l-hummingboard-ripple.dtb \
        rzv2l-hummingboard-extended.dtb;dtb/renesas/rzv2l-hummingboard-extended.dtb \
        rzv2l-hummingboard-pro.dtb;dtb/renesas/rzv2l-hummingboard-pro.dtb \
        rzv2l-hummingboard-pro.dtb;dtb/renesas/rzv2l-hummingboard-iiot.dtb \
        ${OVERLAY_PREFIX}-sd-overlay.dtbo;dtb/renesas/${OVERLAY_PREFIX}-sd-overlay.dtbo \
        ${OVERLAY_PREFIX}-mmc-overlay.dtbo;dtb/renesas/${OVERLAY_PREFIX}-mmc-overlay.dtbo \
"

MACHINEOVERRIDES .= ":solidrun-rzv2l-som"
```

## conf/machine/solidrun-rz-common.inc
```bitbake
require conf/machine/include/cip-core.inc

DEFAULTTUNE ?= "cortexa55"

TUNE_CONF ?= "conf/machine/include/tune-cortexa55.inc"
require ${TUNE_CONF}

PREFERRED_PROVIDER_virtual/kernel = "linux-renesas"
KERNEL_DTC_FLAGS:append = " -@"

# flash writer
EXTRA_IMAGEDEPENDS += "flash-writer boot-overlays"

# build sdcard image by default
IMAGE_FSTYPES += "wic wic.zst wic.bmap"
WKS_DEFAULT_FILE ?= "rzg2lc-sdcard.wks.in"
WKS_FILES ?= "rzg2lc-sdcard.wks.in"
WIC_INPUT_DEPENDS = "firmware-pack:do_deploy flash-writer:do_deploy boot-overlays:do_deploy"

MACHINE_ESSENTIAL_EXTRA_RRECOMMENDS += " kernel-module-brcmfmac kernel-module-brcmutil \
                                        linux-firmware-bcm43439 linux-firmware-bcm43455 \
                                        kernel-module-hci-uart \
                                        u-boot \
                                        kernel-module-leds-lp55xx-common \
                                        kernel-module-leds-lp5562 \
                                        kernel-module-tpm-tis-core \
                                        kernel-module-tpm-tis-spi \
                                        kernel-module-ar0521 \
                                        kernel-module-imx219 \
                                        kernel-module-panel-ronbo-rb070d30 \
                                        kernel-module-gpio-backlight \
                                        kernel-module-ilitek-ts-i2c \
                                        zram \
                                        kernel-module-rswlan \
                                        linux-firmware-da14531 \
                                        linux-firmware-da16200 \
                                        kernel-module-adxl345-core \
                                        kernel-module-adxl345-i2c \
                                        kernel-module-gnss-serial \
                                        kernel-module-gnss-ubx \
                                        kernel-module-i2c-gpio \
                                        kernel-module-pps-gpio \
"

MACHINE_FEATURES += "bluetooth wifi"

MACHINEOVERRIDES .= ":solidrun-rz"
```

## meta-rzg2l/conf/layer.conf
```bitbake
# We have a conf and classes directory, add to BBPATH
BBPATH .= ":${LAYERDIR}"

# We have recipes-* directories, add to BBFILES
BBFILES += "${LAYERDIR}/recipes-*/*/*.bb \
            ${LAYERDIR}/recipes-*/*/*.bbappend"

BBFILE_COLLECTIONS += "solidrun-rz-g2l"
BBFILE_PATTERN_solidrun-rz-g2l = "^${LAYERDIR}/"
BBFILE_PRIORITY_solidrun-rz-g2l= "15"
LAYERVERSION_solidrun-rz-g2l = "1"
LAYERSERIES_COMPAT_solidrun-rz-g2l = "scarthgap"
```

## meta-rzg2l/conf/machine/include/rzg2l-sr-som-common.conf
```bitbake
#
# Configuration shared between RZ/G2 Series SoMs:
# - RZ/G2LC SoM
# - RZ/G2L SoM
# - RZ/V2L SoM
#

require conf/machine/include/arm/armv8-2a/tune-cortexa55.inc
require conf/machine/include/rz-common.inc
require conf/machine/include/rzg2l-family.inc
MACHINEOVERRIDES =. "rzg2l-sr-som-common:"

SERIAL_CONSOLES ?= "115200;ttySC0"

# Machine configuration
MACHINE_FEATURES = "opengles opencl mali-g31 bluetooth rtc serial usbgadget usbhost wifi"

IMAGE_FSTYPES:append = " tar.bz2 ext4"

# Configuration for ARM Trusted Firmware
EXTRA_IMAGEDEPENDS += " trusted-firmware-a"

# flash writer
EXTRA_IMAGEDEPENDS += " flash-writer"

# Firmware-pack
EXTRA_IMAGEDEPENDS += " firmware-pack"

# Linux kernel configuration
KERNEL_IMAGETYPE = "Image.gz"

# Trusted Firmware-A configuration
PREFERRED_VERSION_trusted-firmware-a ?= "2.9%"
TFA_UBOOT ?= "1"
TFA_BUILD_TARGET ?= "bl2 bl31 fip"

BL2_BASE_ADDR ?= "0x00012000"
BL2_BOOT_TARGET ?= "mmc esd"
BL2_ADJUST_VMA ?= "0x00011E00"
FIP_ADJUST_VMA ?= "0x0000"

# SolidRun eMMC-/SD-Mux Overlays
SR_MMC_OVERLAY ?= "rzg2l-solidrun-mmc-overlay.dtbo"
SR_SD_OVERLAY ?= "rzg2l-solidrun-sd-overlay.dtbo"

# U-Boot Configuration
UBOOT_CONFIG[rzg2ul-hummingboard] = "rzg2ul-solidrun_defconfig"
UBOOT_CONFIG[rzg2lc-hummingboard] = "rzg2lc-solidrun_defconfig"
UBOOT_CONFIG[rzg2l-hummingboard] = "rzg2l-solidrun_defconfig"
UBOOT_CONFIG[rzv2l-hummingboard] = "rzv2l-solidrun_defconfig"
PREFERRED_VERSION_u-boot ?= "2021.10%"

# Wic image
FIP_WIC_OFFSET = "--offset 128s"
WKS_FILE = "rz-image-bootpart-esd-sr.wks.in"

# install kernel to "Image" filename because wic image extlinux.conf generator does not recognise Image.gz.
# U-Boot decompresses it fine regardless
IMAGE_BOOT_FILES:append = " ${KERNEL_IMAGETYPE};Image "

do_image_wic[depends] += "firmware-pack:do_deploy flash-writer:do_deploy"

# common RZ/G2LC, RZ/G2L, RZ/V2L boot files
IMAGE_BOOT_FILES = " \
	bl2_bp_mmc-${MACHINE}.bin \
	fip-${MACHINE}.bin \
	bl2_bp_mmc-${MACHINE}.srec \
	fip-${MACHINE}.srec \
	Flash_Writer_SCIF_${FLASH_WRITER_BOARD}_DDR4_512MB_1PCS.mot \
	Flash_Writer_SCIF_${FLASH_WRITER_BOARD}_DDR4_1GB_1PCS.mot \
	Flash_Writer_SCIF_${FLASH_WRITER_BOARD}_DDR4_2GB_1PCS.mot \
"

# include drivers & support packages
# RZ/G2LC System on Module
MACHINE_ESSENTIAL_EXTRA_RDEPENDS:append = " \
	kernel-module-brcmfmac \
	kernel-module-brcmutil \
	kernel-module-btbcm \
	kernel-module-cfg80211 \
	kernel-module-hci-uart \
"
# Murata out-of-tree driver
MACHINE_ESSENTIAL_EXTRA_RDEPENDS:append = " kernel-module-murata-cyw-fmac "
# HummingBoard Ripple
MACHINE_ESSENTIAL_EXTRA_RDEPENDS:append = " \
	kernel-module-userspace-consumer \
"
```

## meta-rzg2l/conf/machine/rzg2lc-sr-som.conf
```bitbake
#@TYPE: Machine
#@NAME: SolidRun RZ/G2LC SYstem on Module
#@DESCRIPTION: Machine configuration for SolidRun RZ/G2LC SoM on HummingBoard Ripple

require conf/machine/include/soc-family.inc
SOC_FAMILY = "rzg2l-family:mali-family"
require conf/machine/include/arm/armv8-2a/tune-cortexa55.inc
require conf/machine/include/rz-common.inc

# Machine configuration
MACHINE_FEATURES = "opengles opencl mali-g31 bluetooth rtc serial usbgadget usbhost wifi"

IMAGE_FSTYPES:append = " tar.bz2 ext4"

# Configuration for ARM Trusted Firmware
EXTRA_IMAGEDEPENDS += " trusted-firmware-a"

# flash writer
EXTRA_IMAGEDEPENDS += " flash-writer"

# Firmware-pack
EXTRA_IMAGEDEPENDS += " firmware-pack"

# Linux kernel configuration
PREFERRED_PROVIDER_virtual/kernel ?= "linux-renesas"
PREFERRED_VERSION_linux-renesas ?= "6.1%"
KERNEL_IMAGETYPE ?= "Image.gz"
KERNEL_DEVICETREE = " \
	renesas/${SR_MMC_OVERLAY} \
	renesas/${SR_SD_OVERLAY} \
	renesas/r9a07g044c2-hummingboard-iiot.dtb \
	renesas/r9a07g044c2-hummingboard-ripple.dtb \
	renesas/rzg2lc-hummingboard-pulse-leds.dtbo \
"

# SolidRun eMMC-/SD-Mux Overlays
SR_MMC_OVERLAY ?= "rzg2l-solidrun-mmc-overlay.dtbo"
SR_SD_OVERLAY ?= "rzg2l-solidrun-sd-overlay.dtbo"

# Trusted Firmware-A configuration
PREFERRED_VERSION_trusted-firmware-a ?= "2.9%"
TFA_PLATFORM ?= "g2l"
TFA_BOARD ?= "sr_rzg2lc"
TFA_UBOOT ?= "1"
TFA_BUILD_TARGET ?= "bl2 bl31 fip"
BL2_BOOT_TARGET ?= "mmc esd"
BL2_ADJUST_VMA ?= "0x00011E00"
FIP_ADJUST_VMA ?= "0x0000"

# U-Boot Configuration
UBOOT_CONFIG ??= "rzg2lc-hummingboard"
UBOOT_CONFIG[rzg2lc-hummingboard] = "rzg2lc-solidrun_defconfig"
PREFERRED_VERSION_u-boot ?= "2021.10%"

# Flash Writer configuration
FLASH_WRITER_BOARD ?= "RZG2LC_HUMMINGBOARD"

# Wic image
WKS_FILE = "rz-image-bootpart-esd-sr.wks.in"

# install kernel to "Image" filename because wic image extlinux.conf generator does not recognise Image.gz.
# U-Boot decompresses it fine regardless
IMAGE_BOOT_FILES:append = " ${KERNEL_IMAGETYPE};Image "

# install DTBs with renesas/ prefix
IMAGE_BOOT_FILES:append = " \
	r9a07g044c2-hummingboard-iiot.dtb;renesas/r9a07g044c2-hummingboard-iiot.dtb \
	r9a07g044c2-hummingboard-ripple.dtb;renesas/r9a07g044c2-hummingboard-ripple.dtb \
	rzg2lc-hummingboard-pulse-leds.dtbo;renesas/rzg2lc-hummingboard-pulse-leds.dtbo \
"
# HACK: place one sentinel dtb without renesas/ prefix to fix wic image generated extlinux.conf fdtdir path
IMAGE_BOOT_FILES:prepend = " r9a07g044c2-hummingboard-ripple.dtb;sentinel.dtb "

do_image_wic[depends] += "firmware-pack:do_deploy flash-writer:do_deploy"

# include drivers & support packages
# RZ/G2LC System on Module
MACHINE_ESSENTIAL_EXTRA_RDEPENDS:append = " \
	kernel-module-brcmfmac \
	kernel-module-brcmutil \
	kernel-module-btbcm \
	kernel-module-cfg80211 \
	kernel-module-hci-uart \
	linux-firmware-cyw43439-sr \
"
# RZ/G2LC SoM Murata out-of-tree driver
MACHINE_ESSENTIAL_EXTRA_RDEPENDS:append = " kernel-module-murata-cyw-fmac "
# HummingBoard Ripple
MACHINE_ESSENTIAL_EXTRA_RDEPENDS:append = " \
	kernel-module-userspace-consumer \
"
```

## meta-rzg2l/conf/machine/rzg2ul-sr-som.conf
```bitbake
#@TYPE: Machine
#@NAME: SolidRun RZ/G2LC SYstem on Module
#@DESCRIPTION: Machine configuration for SolidRun RZ/G2LC SoM on HummingBoard Ripple

require conf/machine/include/rzg2l-sr-som-common.conf

# Linux kernel configuration
KERNEL_DEVICETREE += " \
	renesas/${SR_MMC_OVERLAY} \
	renesas/${SR_SD_OVERLAY} \
	renesas/r9a07g043u12-hummingboard-ripple.dtb \
	renesas/rzg2lc-hummingboard-pulse-leds.dtbo \
"

# Trusted Firmware-A configuration
TFA_PLATFORM ?= "g2ul"
TFA_BOARD ?= "sr_rzg2ul"
TFA_SOC_TYPE ?= "2"

# U-Boot Configuration
UBOOT_CONFIG ??= "rzg2ul-hummingboard"

# Flash Writer configuration
FLASH_WRITER_BOARD ?= "RZG2UL_HUMMINGBOARD"

# install DTBs with renesas/ prefix
IMAGE_BOOT_FILES:append = " \
	r9a07g043u12-hummingboard-ripple.dtb;renesas/r9a07g043u12-hummingboard-ripple.dtb \
	rzg2lc-hummingboard-pulse-leds.dtbo;renesas/rzg2lc-hummingboard-pulse-leds.dtbo \
"
# HACK: place one sentinel dtb without renesas/ prefix to fix wic image generated extlinux.conf fdtdir path
IMAGE_BOOT_FILES:prepend = " r9a07g043u12-hummingboard-ripple.dtb;sentinel.dtb "

# include drivers & support packages
MACHINE_ESSENTIAL_EXTRA_RDEPENDS:append = " \
	linux-firmware-sr-rz-cyw43439 \
"
```
